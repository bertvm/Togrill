## main/Kconfig.projbuild
```kconfig
menu "ToGrill CYD"

config TOGRILL_WIFI_SSID
    string "Wi-Fi SSID"
    default ""
    help
        2.4 GHz network the display joins. Leave empty to build a firmware
        that only shows temperatures on the screen.

config TOGRILL_WIFI_PASSWORD
    string "Wi-Fi password"
    default ""

config TOGRILL_MQTT_URI
    string "MQTT broker URI"
    default "mqtt://192.168.1.1:1883"
    help
        Example: mqtt://192.168.1.10:1883
        Used only when a Wi-Fi SSID is set.

config TOGRILL_MQTT_USERNAME
    string "MQTT username"
    default ""

config TOGRILL_MQTT_PASSWORD
    string "MQTT password"
    default ""

config TOGRILL_MQTT_PREFIX
    string "MQTT topic prefix"
    default "togrill"
    help
        Readings are published to <prefix>/state and <prefix>/probe/N.

config TOGRILL_PEER_ADDRESS
    string "Thermometer Bluetooth address"
    default ""
    help
        Optional MAC address, for example AA:BB:CC:DD:EE:FF.
        Empty means connect to the first ToGrill advertisement found.
        The phone app cannot use the thermometer while this link is held.

endmenu
```

## sdkconfig.defaults
```kconfig
CONFIG_IDF_TARGET="esp32"

CONFIG_ESPTOOLPY_FLASHMODE_DIO=y
CONFIG_ESPTOOLPY_FLASHFREQ_40M=y
CONFIG_ESPTOOLPY_FLASHSIZE_4MB=y
CONFIG_PARTITION_TABLE_SINGLE_APP_LARGE=y

CONFIG_COMPILER_OPTIMIZATION_SIZE=y
CONFIG_ESP_MAIN_TASK_STACK_SIZE=8192

CONFIG_BT_ENABLED=y
CONFIG_BTDM_CTRL_MODE_BLE_ONLY=y
CONFIG_BT_BLUEDROID_ENABLED=n
CONFIG_BT_NIMBLE_ENABLED=y
CONFIG_BT_NIMBLE_ROLE_CENTRAL=y
CONFIG_BT_NIMBLE_ROLE_OBSERVER=y
CONFIG_BT_NIMBLE_ROLE_PERIPHERAL=n
CONFIG_BT_NIMBLE_ROLE_BROADCASTER=n
CONFIG_BT_NIMBLE_MAX_CONNECTIONS=1
CONFIG_BT_NIMBLE_HOST_TASK_STACK_SIZE=8192
CONFIG_BTDM_SCAN_DUPL_TYPE_DATA_DEVICE=y

CONFIG_ESP_COEX_SW_COEXIST_ENABLE=y

CONFIG_LV_MEM_SIZE_KILOBYTES=48
CONFIG_LV_FONT_MONTSERRAT_28=y
```
